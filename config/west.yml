## config/west.yml
```yaml
manifest:
  remotes:
    - name: zmkfirmware
      url-base: https://github.com/arqubusier
  projects:
    - name: zmk
      remote: zmkfirmware
      revision: grapto_v3w
      import: app/west.yml
  self:
    path: config
```
